## CMakeLists.txt
```
# SPDX-License-Identifier: Apache-2.0

cmake_minimum_required(VERSION 3.20.0)
set(BOARD stm32f411e_disco)
find_package(Zephyr REQUIRED HINTS $ENV{ZEPHYR_BASE})

project(
  TestApp 
  VERSION 1.0
  DESCRIPTION "Zephyr test application"
  LANGUAGES C  
)

target_sources(
  app
  PRIVATE 
  src/led.c
  src/encoder.c
  src/button.c
  src/main.c
)

target_include_directories(
  app
  PUBLIC
  inc/
)
```

## prj.conf
```kconfig
CONFIG_STDOUT_CONSOLE=y
CONFIG_PRINTK=y
CONFIG_GPIO=y
CONFIG_LOG=y
CONFIG_PWM=y
CONFIG_LOG_PRINTK=y
CONFIG_LOG_MODE_IMMEDIATE=y
CONFIG_PWM_LOG_LEVEL_DBG=y
CONFIG_DEBUG_INFO=y
```

## src/main.c
```c
/**
 * This program uses external buttons as inputs for setting and resetting the LED controlled by PWM.
 * An encoder is used to alter the intensity of the LED which is set after a button is pressed. If the
 * user wants to reset the intensity to the minimum value, a reset button can be pressed.
*/
#include "main.h"

// 1000 msec = 1 sec
#define SLEEP_TIME_MS     5u

/**
 * @brief Initialize modules
*/
int initialize(void)
{
  int ret = 0u;

  ret = initButton();
  if (ret != 0) {
    return ret;
  }

  ret = initEncoder();
  if (ret != 0) {
    return ret;
  }

  ret = initPWM();
  if (ret != 0) {
    return ret;
  }

  return ret;
}

int main(void)
{
  int ret = 0u;

  ret = initialize();
  if (ret != 0) {
    printk("Error initializing");
    return ret;
  }

  while (1) {
    // Update encoder every 1ms
    updateEncoder();
    
    // Delay
    k_msleep(SLEEP_TIME_MS);
  }
  
  return ret;
}
```

## inc/button.h
```c
#ifndef BUTTON_H
#define BUTTON_H

#include <stdio.h>
#include <stdint.h>
#include <zephyr/kernel.h>
#include <zephyr/device.h>
#include <zephyr/drivers/gpio.h>

#include "led.h"
#include "encoder.h"

int initButton(void);

extern uint32_t encoder_val;

#endif // BUTTON_H
```

## inc/encoder.h
```c
#ifndef ENCODER_H
#define ENCODER_H

#include <stdio.h>
#include <stdint.h>
#include <zephyr/kernel.h>
#include <zephyr/device.h>
#include <zephyr/drivers/gpio.h>

#include "led.h"

#define STEPSIZE          100000u

extern uint32_t encoder_val;

int initEncoder(void);
void updateEncoder(void);

#endif // ENCODER_H
```

## inc/led.h
```c
#ifndef LED_H
#define LED_H

#include <stdio.h>
#include <stdint.h>
#include <zephyr/kernel.h>
#include <zephyr/device.h>
#include <zephyr/drivers/gpio.h>
#include <zephyr/drivers/pwm.h>

#include "encoder.h"

extern uint32_t max_period;
extern uint32_t min_period;

int initLED(void);
int initPWM(void);
void updatePwmLED(uint32_t enc_val);

#endif // LED_H
```

## inc/main.h
```c
#ifndef MAIN_H
#define MAIN_H

#include <stdio.h>
#include <stdint.h>
#include <zephyr/kernel.h>
#include <zephyr/device.h>
#include <zephyr/drivers/gpio.h>
#include <zephyr/drivers/pwm.h>

#include "encoder.h"
#include "button.h"
#include "led.h"

#endif // MAIN_H
```

## src/button.c
```c
/**
 * This module contains code pertaining to the external buttons used to set and reset the LED
 * Set Button   - PE1
 * Reset Button - PE3
*/
#include "button.h"

// The devicetree node identifiers for aliases
#define EXT_BUTTON0       DT_ALIAS(ext_button0)
#define EXT_BUTTON1       DT_ALIAS(ext_button1)

// GPIO Callback
static struct gpio_callback set_button_cb_data;
static struct gpio_callback reset_button_cb_data;

// Set and reset buttons
const struct gpio_dt_spec setButton = GPIO_DT_SPEC_GET_OR(EXT_BUTTON0, gpios, {0});
const struct gpio_dt_spec resetButton = GPIO_DT_SPEC_GET_OR(EXT_BUTTON1, gpios, {0});

// Local Prototype
void set_button_pressed(const struct device *dev, struct gpio_callback *cb, uint32_t pins);
void reset_button_pressed(const struct device *dev, struct gpio_callback *cb, uint32_t pins);

/**
 * @brief     Initialize buttons
 * @return    Error/Success code
*/
int initButton(void)
{
  int ret;

  // Setup Set button
  // Check if GPIO is ready
  if (!gpio_is_ready_dt(&setButton)) {
    printk("Error: Button Device %s is not ready\n", 
            setButton.port->name);
    return 1;
  }

  // Configure GPIO as input/output
  ret = gpio_pin_configure_dt(&setButton, GPIO_INPUT);
  if (ret != 0) {
    printk("Error %d: Failed to configure %s pin %d\n", 
            ret, setButton.port->name, setButton.pin);
    return ret;
  }

  // Configure interrupt
  ret = gpio_pin_interrupt_configure_dt(&setButton, GPIO_INT_EDGE_TO_ACTIVE);
  if (ret != 0) {
		printk("Error %d: failed to configure interrupt on %s pin %d\n",
			ret, setButton.port->name, setButton.pin);
		return ret;
  }

  // Setup Reset button
  // Check if GPIO is ready
  if (!gpio_is_ready_dt(&resetButton)) {
    printk("Error: Button Device %s is not ready\n", 
            resetButton.port->name);
    return 1;
  }

  // Configure GPIO as input/output
  ret = gpio_pin_configure_dt(&resetButton, GPIO_INPUT);
  if (ret != 0) {
    printk("Error %d: Failed to configure %s pin %d\n", 
            ret, resetButton.port->name, resetButton.pin);
    return ret;
  }

  // Configure interrupt
  ret = gpio_pin_interrupt_configure_dt(&resetButton, GPIO_INT_EDGE_TO_ACTIVE);
  if (ret != 0) {
		printk("Error %d: failed to configure interrupt on %s pin %d\n",
			ret, resetButton.port->name, resetButton.pin);
		return ret;
  }

  // Configure set button callback functions
  gpio_init_callback(&set_button_cb_data, set_button_pressed, BIT(setButton.pin));
  gpio_add_callback(setButton.port, &set_button_cb_data);
	printk("Set up button at %s pin %d\n", setButton.port->name, setButton.pin);
  
  // Configure reset button callback functions
  gpio_init_callback(&reset_button_cb_data, reset_button_pressed, BIT(resetButton.pin));
  gpio_add_callback(resetButton.port, &reset_button_cb_data);
	printk("Reset up button at %s pin %d\n", resetButton.port->name, resetButton.pin);

  return ret;
}

/**
 * @brief         Callback function for when the set button is pressed.
 *                This interrupt updates the PWM LED's value to the current encoder value
 * @param dev     Device Info
 * @param cb      GPIO Callback struct
 * @param pins    GPIO Pins
*/
void set_button_pressed(const struct device *dev, struct gpio_callback *cb, uint32_t pins)
{
	printk("Set Button pressed at %" PRIu32 "\n", k_cycle_get_32());
  printk("Encoder Val: %d \n", encoder_val);
  updatePwmLED(encoder_val);
}

/**
 * @brief         Callback function for when the reset button is pressed.
 *                This interrupt updates the PWM LED's value to the minimum value
 * @param dev     Device Info
 * @param cb      GPIO Callback struct
 * @param pins    GPIO Pins
*/
void reset_button_pressed(const struct device *dev, struct gpio_callback *cb, uint32_t pins)
{
	printk("Reset Button pressed at %" PRIu32 "\n", k_cycle_get_32());
  encoder_val = STEPSIZE;
  printk("Encoder Val: %d \n", encoder_val);
  updatePwmLED(encoder_val);
}
```

## src/encoder.c
```c
/**
 * Contains encoder data
 * Encoder layout:
 * - COM  -> GND
 * - B    -> PC9
 * - A    -> PC7
*/
#include "encoder.h"

// The devicetree node identifiers for aliases
#define ENC_RIGHT         DT_ALIAS(enc_right)
#define ENC_LEFT          DT_ALIAS(enc_left)

// Encoder left and right pins
static const struct gpio_dt_spec enc_right = GPIO_DT_SPEC_GET(ENC_RIGHT, gpios);
static const struct gpio_dt_spec enc_left = GPIO_DT_SPEC_GET(ENC_LEFT, gpios);

// Callback functions
static struct gpio_callback encoder_cb_right;
static struct gpio_callback encoder_cb_left;

// Encoder state/direction
static uint8_t lastState;
static uint8_t dir;

// Global definitions
uint32_t encoder_val = STEPSIZE;

// Local Prototypes
void encoder_right(const struct device *dev, struct gpio_callback *cb, uint32_t pins);
void encoder_left(const struct device *dev, struct gpio_callback *cb, uint32_t pins);

/**
 * @brief     Initialize encoder
 * @return    Error/Success code
*/
int initEncoder(void)
{
  int ret = 0u;
  lastState = 0u;
  dir = 0u;

  // Check if GPIO for encoder right is ready
  if (!gpio_is_ready_dt(&enc_right)) {
    printk("Error: Enc Right Device %s is not ready\n", 
            enc_right.port->name);
    return 1;
  }

  // Configure GPIO as input/output
  ret = gpio_pin_configure_dt(&enc_right, GPIO_INPUT);
  if (ret != 0) {
    printk("Error %d: Failed to configure %s pin %d\n", 
            ret, enc_right.port->name, enc_right.pin);
    return ret;
  }

  // Configure interrupt
  ret = gpio_pin_interrupt_configure_dt(&enc_right, GPIO_INT_EDGE_TO_ACTIVE);
  if (ret != 0) {
		printk("Error %d: failed to configure interrupt on %s pin %d\n",
			ret, enc_right.port->name, enc_right.pin);
		return ret;
  }

  // Check if GPIO for encoder left is ready
  if (!gpio_is_ready_dt(&enc_left)) {
    printk("Error: Enc Left Device %s is not ready\n", 
            enc_left.port->name);
    return ret;
  }

  // Configure GPIO as input/output
  ret = gpio_pin_configure_dt(&enc_left, GPIO_INPUT);
  if (ret != 0) {
    printk("Error %d: Failed to configure %s pin %d\n", 
            ret, enc_left.port->name, enc_left.pin);
    return ret;
  }

  // Configure interrupt
  ret = gpio_pin_interrupt_configure_dt(&enc_left, GPIO_INT_EDGE_TO_ACTIVE);
  if (ret != 0) {
		printk("Error %d: failed to configure interrupt on %s pin %d\n",
			ret, enc_left.port->name, enc_left.pin);
		return ret;
  }

  // Configure encoder right callback functions
  gpio_init_callback(&encoder_cb_right, encoder_right, BIT(enc_right.pin));
  gpio_add_callback(enc_right.port, &encoder_cb_right);
	printk("Set up pin at %s pin %d\n", enc_right.port->name, enc_right.pin);

  // Configure encoder left callback functions
  gpio_init_callback(&encoder_cb_left, encoder_left, BIT(enc_left.pin));
  gpio_add_callback(enc_left.port, &encoder_cb_left);
	printk("Set up pin at %s pin %d\n", enc_left.port->name, enc_left.pin);

  return ret;
}

/**
 * @brief         Callback function for when the encoder moves counter clock-wise.
 *                This is mainly used for debugging purposes.
 * @param dev     Device Info
 * @param cb      GPIO Callback struct
 * @param pins    GPIO Pins
*/
void encoder_right(const struct device *dev, struct gpio_callback *cb, uint32_t pins)
{
  printk("Encoder moved right: %d\n", encoder_val);
}

/**
 * @brief         Callback function for when the encoder moves clock-wise.
 *                This is mainly used for debugging purposes.
 * @param dev     Device Info
 * @param cb      GPIO Callback struct
 * @param pins    GPIO Pins
*/
void encoder_left(const struct device *dev, struct gpio_callback *cb, uint32_t pins)
{
  printk("Encoder moved left: %d\n", encoder_val);
}

/**
 * @brief Updates encoder every 1ms based on the direction (clock/counter-clock wise)
 *        lastState - holds the previous state of the encoder
 *        state     - Logic OR of the encoder's pins (enc_a and enc_b)
 * 
 *        Signals A and B are generated when they make contact with common ground. Since the
 *        encoder moves and connects/disconnects these signals from ground as it turns, the
 *        signals need to know the previous state in order to retain knowledge of the direction
 *        of the encoder
 */
void updateEncoder(void)
{
  uint8_t enc_a = (uint8_t)gpio_pin_get_dt(&enc_left);
  uint8_t enc_b = (uint8_t)gpio_pin_get_dt(&enc_right) << 1;
  uint8_t state = enc_a | enc_b;
  
  // Finite State Machine to protect against both encoder pins being active
  if (lastState != state) {
    switch (state) {
      // NOT Enc_A OR Enc_B
      case 0:
        if (lastState == 2) {
          encoder_val -= (STEPSIZE * 4);
          dir = 0u;
        } else if (lastState == 1) {
          encoder_val += (STEPSIZE * 4);
          dir = 1u;
        }
        break;

      // Enc_A
      case 1:
        if (lastState == 0) {
          encoder_val -= (STEPSIZE * 4);
          dir = 0u;
        } else if (lastState == 1) {
          encoder_val += (STEPSIZE * 4);
          dir = 1u;
        }
        break;
      
      // Enc_B
      case 2:
        if (lastState == 3) {
          encoder_val -= (STEPSIZE * 4);
          dir = 0u;
        } else if (lastState == 0) {
          encoder_val += (STEPSIZE * 4);
          dir = 1u;
        }
        break;

      // Enc_A AND Enc_B
      case 3:
        if (lastState == 1) {
          encoder_val -= (STEPSIZE * 4);
          dir = 0u;
        } else if (lastState == 2) {
          encoder_val += (STEPSIZE * 4);
          dir = 1u;
        }
        break;
      default:
        break;
    }
  }

  // Limit the bounds of the encoder value
  if (encoder_val <= (STEPSIZE + (STEPSIZE * 0.5))) {
    encoder_val = STEPSIZE;
  } else if (encoder_val >= min_period) {
    if (dir) {
      encoder_val = min_period;
    } else {
      encoder_val = STEPSIZE;
    }
  }

  // Retain last state
  lastState = state;
}
```

## src/led.c
```c
/**
 * This module contains code pertaining to the LED controlled by PWM
 * LED - PC6 (PWM/TIM3_CH1)
*/

#include "led.h"

// The devicetree node identifiers for aliases
#define EXT_PWM_LED1      DT_ALIAS(pwm_ext_led1)
#define MIN_PERIOD        PWM_SEC(1U) / 128U
#define MAX_PERIOD        PWM_SEC(1U)

// LED
static const struct pwm_dt_spec pwm_led0 = PWM_DT_SPEC_GET(EXT_PWM_LED1);
static uint8_t dir;

// Global definitions
uint32_t max_period = STEPSIZE;
uint32_t min_period = MIN_PERIOD;

/**
 * @brief Initialize PWM for the external LED and ensure it is calibrated correctly
*/
int initPWM(void)
{
  dir = 0u;

  if (!pwm_is_ready_dt(&pwm_led0)) {
		printk("Error: PWM device %s is not ready\n", pwm_led0.dev->name);
		return 1;
	}

  /*
	 * In case the default MAX_PERIOD value cannot be set for
	 * some PWM hardware, decrease its value until it can.
	 *
	 * Keep its value at least MIN_PERIOD * 4 to make sure
	 * the sample changes frequency at least once.
	 */
	printk("Calibrating for channel %d...\n", pwm_led0.channel);
	max_period = MAX_PERIOD;
	while (pwm_set_dt(&pwm_led0, max_period, max_period / 2U)) {
		max_period /= 2U;
		if (max_period < (4U * MIN_PERIOD)) {
			printk("Error: PWM device does not support a period at least %lu\n",
			       4U * MIN_PERIOD);
			return 1;
		}
	}

	printk("Done calibrating; maximum/minimum periods %u/%lu nsec\n",
	       max_period, MIN_PERIOD);

  return 0;
}

/** 
 * @brief   Update PWM values based on encoder's value
 *          https://docs.zephyrproject.org/latest/hardware/peripherals/pwm.html
 * @param encoder_val		Value from encoder
*/
void updatePwmLED(uint32_t encoder_val)
{
  int ret;
  uint32_t step = pwm_led0.period / 50u;

  if (dir) {
    if (encoder_val >= pwm_led0.period) {
      encoder_val = pwm_led0.period - step;
      dir = 0U;
    }
  } else {
    if (encoder_val >= step) {
      encoder_val -= step;
    } else {
      encoder_val = step;
      dir = 1U;
    }
  }

  ret = pwm_set_pulse_dt(&pwm_led0, encoder_val);
  if (ret) {
    printk("Error %d: failed to set pulse width\n", ret);
  }
}
```
